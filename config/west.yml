## config/west.yml
```yaml
manifest:
  remotes:
    - name: zmkfirmware
      url-base: https://github.com/petejohanson
  projects:
    - name: zmk
      remote: zmkfirmware
      revision: 40adb3858df5509bd6c67b0477e8832fe769a507
      import: app/west.yml
  self:
    path: config
```
